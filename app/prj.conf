## CMakeLists.txt
```
#-------------------------------------------------------------------------------
# Zephyr Example Application
#
# Copyright (c) 2021 Nordic Semiconductor ASA
# SPDX-License-Identifier: Apache-2.0

cmake_minimum_required(VERSION 3.13.1)
find_package(Zephyr REQUIRED HINTS $ENV{ZEPHYR_BASE})

set(CMAKE_EXPORT_COMPILE_COMMANDS TRUE)

project(app LANGUAGES CXX C)

zephyr_include_directories(src)

target_include_directories(${CMAKE_PROJECT_NAME}
PRIVATE
  ${CMAKE_CURRENT_SOURCE_DIR}
  ${CMAKE_CURRENT_SOURCE_DIR}/src
)

add_subdirectory(src)
```

## prj.conf
```kconfig
# Copyright (c) 2021 Nordic Semiconductor ASA
# SPDX-License-Identifier: Apache-2.0
#
# This file contains selected Kconfig options for the application.

# see https://docs.zephyrproject.org/latest/kconfig.html
# for config descriptions

CONFIG_GPIO=y
CONFIG_PWM=y
CONFIG_SMF=y
```

## boards/native_sim.conf
```kconfig
# provide debug symbols
CONFIG_DEBUG=y
CONFIG_ASSERT=y
CONFIG_THREAD_NAME=y
CONFIG_NO_OPTIMIZATIONS=y
CONFIG_EXTERNAL_LIBC=y

# sanitizers
CONFIG_ASAN=y
CONFIG_UBSAN=y

# driver emulators
CONFIG_GPIO_EMUL=y

# logging
CONFIG_LOG=y
CONFIG_LOG_MODE_IMMEDIATE=y
CONFIG_LOG_DEFAULT_LEVEL=3
CONFIG_LOG_BACKEND_NATIVE_POSIX=y
```

## src/main.c
```c
/**
 * @file main.c
 */

#include <inttypes.h>
#ifdef CONFIG_BOARD_NATIVE_SIM
    #include <stdlib.h>
#endif

#include <zephyr/kernel.h>
#include <zephyr/sys/printk.h>

#include "BTN.h"
#include "LED.h"

#define SLEEP_MS 500

int entry(void)
{
    if (BTN_init() < 0)
    {
        return 0;
    }

    if (LED_init() < 0)
    {
        return 0;
    }

    LED_pwm(LED0, 25);
    LED_pwm(LED1, 50);
    LED_pwm(LED2, 75);
    LED_pwm(LED3, 100);

    while (!BTN_is_pressed(BTN0))
    {
        k_msleep(SLEEP_MS);
    }

    return 0;
}

int main(void)
{
    int ret = entry();

#ifdef CONFIG_BOARD_NATIVE_SIM
    exit(ret);
#else
    return ret;
#endif
}
```

## src/main.cpp
```c
/**
 * @file main.c
 */

extern "C"
{
#include "BTN.h"
}
// #include "Game/Graphic.h"
#include "BLE/BLE.h"
#include "BLE/AudioService/Audio.h"
#include "assets/baka_mitai_audio.h"
// #include "BLE/ControllerService/Controller.h"
// #include "assets/slot_spin_audio.h"
// #include "assets/slot_win_audio.h"
// #include "Game/SlotMachine/slot_machine_logic.h"
// #include "lvgl.h"

namespace
{
// singletons must be stored as references; the copy constructors are deleted
auto& BLE_Audio = ble::AudioService::GetInstance();
// auto& BLE_Controller = ble::Controller::GetInstance();

// void increase_multiplier_async(void*) { slot_machine_increase_multiplier(); }
// void decrease_multiplier_async(void*) { slot_machine_decrease_multiplier(); }
// void start_spin_async(void*)
// {
//     const bool was_animating = slot_machine_is_animating();
//
//     slot_machine_start_spin(lv_tick_get());
//
//     if (!was_animating && slot_machine_is_animating())
//     {
//         BLE_Audio.Start(slot_spin_audio, slot_spin_audio_len);
//     }
// }
// void risk_red_async(void*) { slot_machine_resolve_risk(true); }
// void risk_blue_async(void*) { slot_machine_resolve_risk(false); }
// void collect_risk_async(void*) { slot_machine_collect_risk(); }
// void reset_machine_async(void*) { slot_machine_reset(); }

bool Init() { return (0 == BTN_init()) && ble::Init(); }

/*
void input_listener(const char C)
{
    switch (C)
    {
        case 'q':
        case 'Q':
            lv_async_call(increase_multiplier_async, nullptr);
            break;

        case 'w':
        case 'W':
            lv_async_call(decrease_multiplier_async, nullptr);
            break;

        case 'e':
        case 'E':
            lv_async_call(start_spin_async, nullptr);
            break;

        case 'a':
        case 'A':
            lv_async_call(risk_red_async, nullptr);
            break;

        case 'd':
        case 'D':
            lv_async_call(risk_blue_async, nullptr);
            break;

        case 'c':
        case 'C':
            lv_async_call(collect_risk_async, nullptr);
            break;

        case 'r':
        case 'R':
            lv_async_call(reset_machine_async, nullptr);
            break;

        default:
            // ignore other keys
            break;
    }
}
*/
} // namespace

int main(void)
{
    if (!Init())
    {
        return 0;
    }
    printk("booted");

    while (true)
    {
        if (BTN_check_clear_pressed(BTN0))
        {
            BLE_Audio.Start(baka_mitai_audio, baka_mitai_audio_len);
        }
        // const auto& KeyPress = BLE_Controller.TakeKeyPress();
        // if (KeyPress.has_value())
        // {
        //     printk("KeyPress : %d", KeyPress.value_or(-1));
        //     input_listener(KeyPress.value());
        // }

        // Graphic::Render();
        // if (slot_machine_consume_win_audio_request())
        // {
        // }
        // k_msleep(25);
    }
    return 0;
}
```
